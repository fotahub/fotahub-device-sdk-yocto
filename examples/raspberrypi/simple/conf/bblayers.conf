## examples/raspberrypi/simple/conf/bblayers.conf
```bitbake
CONF_VERSION = "7"

BBPATH = "${TOPDIR}"
LAYERS_DIR = "/yocto/layers"

BBFILES ?= ""
BBLAYERS = " \
  ${LAYERS_DIR}/poky/meta \
  ${LAYERS_DIR}/poky/meta-poky \
  \
  ${LAYERS_DIR}/meta-openembedded/meta-oe \
  ${LAYERS_DIR}/meta-openembedded/meta-filesystems \
  ${LAYERS_DIR}/meta-openembedded/meta-python \
  ${LAYERS_DIR}/meta-openembedded/meta-networking \
  \
  ${LAYERS_DIR}/meta-raspberrypi \
  \
  ${LAYERS_DIR}/meta-updater \
  ${LAYERS_DIR}/meta-updater-raspberrypi \
  ${LAYERS_DIR}/meta-fotahub \
"
```

## examples/raspberrypi/simple/conf/local.conf
```bitbake
CONF_VERSION = "1"

MACHINE = "raspberrypi3"

# Set root password
INHERIT += "extrausers"
EXTRA_USERS_PARAMS = "usermod -P root root;"

# Comment this line to disable SSH server on target
EXTRA_IMAGE_FEATURES += "${@bb.utils.contains('DISTRO', 'fotahub-os', 'ssh-server-dropbear', '', d)}"

# Comment this line to disable SSH-ing into target as root 
EXTRA_IMAGE_FEATURES += "allow-empty-password"

DL_DIR = "/build/yocto/downloads"

FOTAHUB_OSTREEPUSH_USER = "root"
FOTAHUB_OSTREEPUSH_PASS = "root"

OSTREE_GPG_VERIFY = "false"

OS_UPDATE_VERIFICAITON_COMMAND = "bash -c 'echo \"The downloaded OS update revision $1 looks good!\"'"
OS_UPDATE_SELF_TEST_COMMAND = "bash -c 'echo \"The freshly applied OS update runs very well!\"'"

# Uncomment to add some extra packages to OS image
# IMAGE_INSTALL_append = " nano figlet pv"
```

## examples/raspberrypi/tensorflow-lite/conf/local.conf
```bitbake
CONF_VERSION = "1"

DISTRO = "fotahub-os"
MACHINE = "raspberrypi3"

# Uncomment to get configuration for WIMAXIT M1160S 1920X1080 11.6" portable monitor 
# automatically to config.txt file in boot partition
# (see https://wimaxit.com/products/wimaxit-m1160s-portable-monitor for details)
# WIMAXIT_1920x1080_11_6 = "1"

DISABLE_RPI_BOOT_LOGO = "1"

VIDEO_CAMERA = "1"
RASPBERRYPI_CAMERA_V2 = "1"

# Set RPI_WIFI_ENABLE to "1" and configure RPI_WIFI_SSID/RPI_WIFI_PWD as appropriate to enable Wi-Fi
RPI_WIFI_ENABLE = "0"
RPI_WIFI_SSID = "<Your Wi-Fi SSID>"
RPI_WIFI_PWD = "<Your Wi-Fi password>"

# Set root password
INHERIT += "extrausers"
EXTRA_USERS_PARAMS = "usermod -P root root;"

# Comment this line to disable SSH server on target
EXTRA_IMAGE_FEATURES += "ssh-server-dropbear"

# Comment this line to disable SSH-ing into target as root 
EXTRA_IMAGE_FEATURES += "allow-root-login"

# Comment/uncomment these lines to enable/disable graphics support in OS image
# DISTRO_FEATURES_remove = "x11"

DL_DIR = "/yocto/downloads"

FOTAHUB_OSTREEPUSH_USER = "root"
FOTAHUB_OSTREEPUSH_PASS = "root"

OSTREE_GPG_VERIFY = "false"

OS_UPDATE_REBOOT_OPTIONS = "--force"
OS_UPDATE_VERIFICAITON_COMMAND = "bash -c 'echo \"The downloaded OS update (revision \$1) looks good!\"'"
OS_UPDATE_SELF_TEST_COMMAND = "bash -c 'echo \"The freshly applied OS update runs very well!\"'"

IMAGE_INSTALL_append = " tflite-object-detection"
# IMAGE_INSTALL_append = " tflite-face-mask-detector"
```
